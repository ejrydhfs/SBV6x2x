## 1.0.2.0SCM01/linux-2.6.18/src/arch/arm/mach-avalanche/ti_puma5/Kconfig
```kconfig
menu "TI Puma5 Configuration"
    depends on MACH_PUMA5 = 'y'

#
# All the configuration options specific to a particular SoC come here.
#

# Get to know the reference board the user wants to compile for
choice
	prompt "Puma5 reference board type"
	help
      Select the Puma5 Ref. Design Board that you are using. If you are not 
      using any of these, choose the one closest to your design and make 
      modifications to the kernel as required.

config MACH_PUMA5_VOLCANO
	bool "Volcano FPGA Emulation Board"

config MACH_PUMA5EVM
	bool "Puma5 EVM Board"

endchoice

choice
	prompt "Bootloader"
	default AVALANCHE_ADAM2
	help
      Select bootloader used to boot Puma5.

config AVALANCHE_ADAM2
	bool "Bootloader is Adam2"

config AVALANCHE_U_BOOT
	bool "Bootloader is u-boot"

endchoice

config ARM_AVALANCHE_SPI
        bool "Avalanche SPI support"
        depends on SPI
        default y
        help
          Choose y to compile the Avalanche SPI driver.

config PSP_TRACE
        bool "PSP trace support"
        default y
        help
          choose y to compile psp trace support
		  
config ARM_AVALANCHE_CPGMAC_F
	tristate "Texas Instruments Avalanche CPGMAC support"       
    default m
    select AVALANCHE_LOW_CPMAC 
    help
        Choose y/m, to compile the TI Avalanche CPMAC driver.

config  ARM_CPMAC_PORTS 
	int 
	range 1 1
	default "1"

config  AVALANCHE_LOW_CPMAC 
    bool 

config ARM_CPMAC_DS_TRAFFIC_PRIORITY
        bool "Downstream Traffic Priority support"
        default y
        select TI_META_DATA
	help
          choose y enable Downstream Traffic Priority support

config ARM_AVALANCHE_PPD
    tristate "Texas Instruments Packet Processor Driver"
    default y
    help
        Choose y to compile in the packet processor driver for packet processing acceleration.

config ARM_AVALANCHE_PPD_TEST
    bool "Packet Processor Test"
    depends on ARM_AVALANCHE_PPD
    default y
    help
        Choose y to compile in the test support for packet processor driver.

config ARM_CPMAC_INIT_BUF_MALLOC
        bool "CPGMAC Init Buffer Malloc"
        depends on ARM_AVALANCHE_CPGMAC_F
        default n if MACH_PUMA5_VOLCANO
        default y if ARM_EXTERNAL_SWITCH 


config ARM_AVALANCHE_USB20_OTG
    tristate "Texas Instruments Avalanche USB 2.0 OTG support"
    default n
    help
      Choose y/m, to compile the TI Avalanche USB 2.0 OTG driver.

config AVALANCHE_NUM_SER_PORTS
	depends on ARM_AVALANCHE_SOC
	int "Number of serial ports"
	default 2
	help
      Choose the correct number of serial ports on your soc here. If unsure
      consult the SoC specification from your vendor, but do not put a 
      wrong value here.

config AVALANCHE_CONSOLE_PORT
	depends on ARM_AVALANCHE_SOC
    int "Port number of the console"
	default 0 
	help
      Choose the Avalanche serial port number functioning as the ttyS0 (console)
      port. The valid values range from 0 through AVALANCHE_NUM_SER_PORTS - 1.

config ARM_AVALANCHE_VLYNQ
    bool "Texas Instruments VLYNQ (TM) bus support"
    default n 
    help
      Choose Y, to compile the TI VLYNQ (TM) bus support.

config ARM_AVALANCHE_VLYNQ_PORTS
    int
	depends on ARM_AVALANCHE_VLYNQ
    default 1
    help
      Define the number of VLYNQ (TM) ports on the board/SoC here.

config AVALANCHE_VLYNQ_POLARITY_LOW
	depends on ARM_AVALANCHE_VLYNQ
    bool
    default y
    help
      Define the number of VLYNQ (TM) ports on the board/SoC here.

config AVALANCHE_VLYNQ_CLK_LOCAL
	depends on ARM_AVALANCHE_VLYNQ
    default n
    bool
    help
      Define whether the VLYNQ (TM) clock is sourced locally or remotely.

config ARM_AVALANCHE_COLORED_LED
    bool "COLOR LED support"
    default y 
    help
      Choose Y, to compile the LED support.

config ARM_AVALANCHE_VLYNQ_PORTS
    int "Number of VLYNQ ports"
	depends on ARM_AVALANCHE_VLYNQ
    default 1
    help
      Define the number of VLYNQ (TM) ports on the board/SoC here.

config AVALANCHE_VLYNQ_POLARITY_LOW
	depends on ARM_AVALANCHE_VLYNQ
    default y
    help
      Define the number of VLYNQ (TM) ports on the board/SoC here.

config AVALANCHE_VLYNQ_CLK_LOCAL
	depends on ARM_AVALANCHE_VLYNQ
    default n
    help
      Define whether the VLYNQ (TM) clock is sourced locally or remotely.

endmenu
```

## 1.0.2.0SCM01/linux-2.6.18/src/drivers/spi/Kconfig
```kconfig
#
# SPI driver configuration
#
# NOTE:  the reason this doesn't show SPI slave support is mostly that
# nobody's needed a slave side API yet.  The master-role API is not
# fully appropriate there, so it'd need some thought to do well.
#

#/* Copyright 2008, Texas Instruments Incorporated
#*
#* This program has been modified from its original operation by 
#* Texas Instruments to do the following:
#* 
#* Explanation of modification:
#*  added avalanche support
#*  
#*
#* THIS MODIFIED SOFTWARE AND DOCUMENTATION ARE PROVIDED
#* "AS IS," AND TEXAS INSTRUMENTS MAKES NO REPRESENTATIONS
#* OR WARRENTIES, EXPRESS OR IMPLIED, INCLUDING BUT NOT LIMITED
#* TO, WARRANTIES OF MERCHANTABILITY OR FITNESS FOR ANY
#* PARTICULAR PURPOSE OR THAT THE USE OF THE SOFTWARE OR
#* DOCUMENTATION WILL NOT INFRINGE ANY THIRD PARTY PATENTS,
#* COPYRIGHTS, TRADEMARKS OR OTHER RIGHTS.
#* See The GNU General Public License for more details.
#*
#* These changes are covered under version 2 of the GNU General Public License,
#* dated June 1991.
#*/

menu "SPI support"

config SPI
	bool "SPI support"
	help
	  The "Serial Peripheral Interface" is a low level synchronous
	  protocol.  Chips that support SPI can have data transfer rates
	  up to several tens of Mbit/sec.  Chips are addressed with a
	  controller and a chipselect.  Most SPI slaves don't support
	  dynamic device discovery; some are even write-only or read-only.

	  SPI is widely used by microcontollers to talk with sensors,
	  eeprom and flash memory, codecs and various other controller
	  chips, analog to digital (and d-to-a) converters, and more.
	  MMC and SD cards can be accessed using SPI protocol; and for
	  DataFlash cards used in MMC sockets, SPI must always be used.

	  SPI is one of a family of similar protocols using a four wire
	  interface (select, clock, data in, data out) including Microwire
	  (half duplex), SSP, SSI, and PSP.  This driver framework should
	  work with most such devices and controllers.

config SPI_DEBUG
	boolean "Debug support for SPI drivers"
	depends on SPI && DEBUG_KERNEL
	help
	  Say "yes" to enable debug messaging (like dev_dbg and pr_debug),
	  sysfs, and debugfs support in SPI controller and protocol drivers.

#
# MASTER side ... talking to discrete SPI slave chips including microcontrollers
#

config SPI_MASTER
#	boolean "SPI Master Support"
	boolean
	default SPI
	help
	  If your system has an master-capable SPI controller (which
	  provides the clock and chipselect), you can enable that
	  controller and the protocol drivers for the SPI slave chips
	  that are connected.

comment "SPI Master Controller Drivers"
	depends on SPI_MASTER

config SPI_BITBANG
	tristate "Bitbanging SPI master"
	depends on SPI_MASTER && EXPERIMENTAL
	help
	  With a few GPIO pins, your system can bitbang the SPI protocol.
	  Select this to get SPI support through I/O pins (GPIO, parallel
	  port, etc).  Or, some systems' SPI master controller drivers use
	  this code to manage the per-word or per-transfer accesses to the
	  hardware shift registers.

	  This is library code, and is automatically selected by drivers that
	  need it.  You only need to select this explicitly to support driver
	  modules that aren't part of this kernel tree.

config SPI_BUTTERFLY
	tristate "Parallel port adapter for AVR Butterfly (DEVELOPMENT)"
	depends on SPI_MASTER && PARPORT && EXPERIMENTAL
	select SPI_BITBANG
	help
	  This uses a custom parallel port cable to connect to an AVR
	  Butterfly <http://www.atmel.com/products/avr/butterfly>, an
	  inexpensive battery powered microcontroller evaluation board.
	  This same cable can be used to flash new firmware.

config SPI_MPC83xx
	tristate "Freescale MPC83xx SPI controller"
	depends on SPI_MASTER && PPC_83xx && EXPERIMENTAL
	select SPI_BITBANG
	help
	  This enables using the Freescale MPC83xx SPI controller in master
	  mode.

	  Note, this driver uniquely supports the SPI controller on the MPC83xx
	  family of PowerPC processors.  The MPC83xx uses a simple set of shift
	  registers for data (opposed to the CPM based descriptor model).

config SPI_PXA2XX
	tristate "PXA2xx SSP SPI master"
	depends on SPI_MASTER && ARCH_PXA && EXPERIMENTAL
	help
	  This enables using a PXA2xx SSP port as a SPI master controller.
	  The driver can be configured to use any SSP port and additional
	  documentation can be found a Documentation/spi/pxa2xx.

config SPI_S3C24XX_GPIO
	tristate "Samsung S3C24XX series SPI by GPIO"
	depends on SPI_MASTER && ARCH_S3C2410 && SPI_BITBANG && EXPERIMENTAL
	help
	  SPI driver for Samsung S3C24XX series ARM SoCs using
	  GPIO lines to provide the SPI bus. This can be used where
	  the inbuilt hardware cannot provide the transfer mode, or
	  where the board is using non hardware connected pins.

config SPI_OMAP_UWIRE
	tristate "OMAP MicroWire"
	depends on SPI_MASTER && ARCH_OMAP
	select SPI_BITBANG
	help
	  This hooks up to the MicroWire controller on OMAP chips.

config SPI_OMAP24XX
    bool "McSPI driver for OMAP24xx"
	depends on SPI_MASTER && ARCH_OMAP24XX
	help
	  SPI master controller for OMAP24xx McSPI modules.

config SPI_MXC
    tristate "MXC CSPI controller as SPI Master"
    depends on ARCH_MXC && SPI_MASTER
    select SPI_BITBANG
    help
      This implements the SPI master mode using MXC CSPI.

config SPI_MXC_TEST_LOOPBACK
    bool "LOOPBACK Testing of CSPIs"
    depends on SPI_MXC
    default n

config SPI_MXC_SELECT1
    bool "CSPI1"
    depends on SPI_MXC
    default y

config SPI_MXC_SELECT2
    bool "CSPI2"
    depends on SPI_MXC
    default n

config SPI_MXC_SELECT3
    bool "CSPI3"
    depends on SPI_MXC && (ARCH_MX3 || ARCH_MX27)
    default n

config SPI_TI_CODEC
	bool "SPI interface in TI Codec implementation"
	depends on SPI_MASTER && ARCH_AVALANCHE
	help
	  SPI master controller in TI Codec implementation.

choice
    prompt "SPI Operating Mode"
    depends on ARCH_AVALANCHE && SPI 
    default SPI_POLLING_MODE
    help
      Specifies the operating mode. Available mode - Pure Interrupt,
      Polling and tasklet

config SPI_INTERRUPT_MODE
    boolean "SPI Pure Interrupt Mode"
    help
      Works in pure interrupt mode. Interrupts will be generated for
      every word.

config SPI_TASKLET_MODE
    boolean "SPI Tasklet Mode"
    help
      Works in tasklet mode. Only one interrupt will be generated for
      each transfer and the remaining transfer happens in a tasklet

config SPI_POLLING_MODE
    boolean "SPI Polling Mode"
    help
      Works in polling mode. (Not recommended)

endchoice

#
# Add new SPI master controllers in alphabetical order above this line
#


config SPI_S3C24XX
	tristate "Samsung S3C24XX series SPI"
	depends on SPI_MASTER && ARCH_S3C2410 && EXPERIMENTAL
	help
	  SPI driver for Samsung S3C24XX series ARM SoCs

#
# There are lots of SPI device types, with sensors and memory
# being probably the most widely used ones.
#
comment "SPI Protocol Masters"
	depends on SPI_MASTER

config TSC2102
	depends on SPI_MASTER
	tristate "TSC2102 codec support"
	---help---
	  Say Y here if you want support for the TSC2102 chip.  It
	  will be needed for the touchscreen driver on some boards.

config SPI_SPIDEV
	tristate "User mode SPI device driver support"
	depends on SPI_MASTER && EXPERIMENTAL
	help
	  This supports user mode SPI protocol drivers.

	  Note that this application programming interface is EXPERIMENTAL
	  and hence SUBJECT TO CHANGE WITHOUT NOTICE while it stabilizes.

#
# Add new SPI protocol masters in alphabetical order above this line
#


# (slave support would go here)

endmenu # "SPI support"
```
