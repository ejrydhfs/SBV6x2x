## 1.0.2.0SCM01/ti_dhcpv6/Kconfig
```kconfig
config TI_DHCPv6
	bool "TI DHCPv6 Client"
	depends on TI_FLEX
	default y
	help
		Enable or Disable TI DHCPv6 Client.

config TI_DHCPv6_SAMPLE_PLUGIN
	bool "Install sample DHCPv6 plugins"
	depends on TI_DHCPv6
	default n
	help
		Enables compilation and installation of sample plugins for DHCPv6 client.
```

## 1.0.2.0SCM01/ti_tftp/Kconfig
```kconfig
config TI_TFTP
    bool "TI TFTP client"
    default y
    help
        Enable or Disable TI Trivial File Transfer Protocol (TFTP) client.

config TI_TFTP_SAMPLE_PLUGIN
    bool "TI TFTP client plugin with shared library"
    depends on TI_TFTP
    default n
    help
        Build TFTP plugin to be built statically linked or as an executable with shared library.
```
